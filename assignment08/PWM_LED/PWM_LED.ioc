# file: PWM_LED.ioc
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Mcu.Family=STM32L4
Mcu.Name=STM32L475V(C-E-G)Tx
Mcu.Package=LQFP100
NVIC.PriorityGroup=NVIC_PRIORITYGROUP_4
NVIC.TIM1_TRG_COM_TIM17_IRQn=true\:15\:0\:false\:false\:true\:false\:true
NVIC.TimeBase=TIM1_TRG_COM_TIM17_IRQn
NVIC.TimeBaseIP=TIM17
PB14.Signal=S_TIM15_CH1
ProjectManager.HeapSize=0x200
ProjectManager.StackSize=0x400
ProjectManager.TargetToolchain=EWARM V8.32
RCC.ADCFreq_Value=48000000
RCC.AHBFreq_Value=80000000
RCC.APB1Freq_Value=80000000
RCC.APB1TimFreq_Value=80000000
RCC.APB2Freq_Value=80000000
RCC.APB2TimFreq_Value=80000000
RCC.CortexFreq_Value=80000000
RCC.HCLKFreq_Value=80000000
RCC.HSE_VALUE=8000000
RCC.HSI_VALUE=16000000
RCC.LSE_VALUE=32768
RCC.MSI_VALUE=4000000
RCC.PLLN=40
RCC.PLLSAI1N=24
RCC.SYSCLKFreq_VALUE=80000000
RCC.SYSCLKSource=RCC_SYSCLKSOURCE_PLLCLK
RCC.USBFreq_Value=48000000
RCC.VCOOutputFreq_Value=160000000
SH.S_TIM15_CH1.0=TIM15_CH1,PWM Generation1 CH1
TIM15.Channel-PWM\ Generation1\ CH1=TIM_CHANNEL_1
TIM15.Period=1000-1
TIM15.Prescaler=400-1
TIM15.Pulse-PWM\ Generation1\ CH1=500
VP_SYS_VS_tim17.Mode=TIM17
board=B-L475E-IOT01A1

// file: Src/main.c
/* USER CODE BEGIN Header */
/**
******************************************************************************
* @file           : main.c
* @brief          : Main program body
******************************************************************************
* @attention
*
* <h2><center>&copy; Copyright (c) 2021 STMicroelectronics.
* All rights reserved.</center></h2>
*
* This software component is licensed by ST under BSD 3-Clause license,
* the "License"; You may not use this file except in compliance with the
* License. You may obtain a copy of the License at:
*                        opensource.org/licenses/BSD-3-Clause
*
******************************************************************************
*/
/* USER CODE END Header */
#include "main.h"

TIM_HandleTypeDef htim15;

/* USER CODE BEGIN PV */
int LED2_Value = 0;
int LED2_Value_Rising = 1;
/* USER CODE END PV */

void SystemClock_Config(void);
static void MX_GPIO_Init(void);
static void MX_TIM15_Init(void);
/* USER CODE BEGIN PFP */
void LED2_PWM_SetValue(uint16_t value);
/* USER CODE END PFP */

int main(void)
    {

        /* MCU Configuration--------------------------------------------------------*/

        /* Reset of all peripherals, Initializes the Flash interface and the Systick. */
        HAL_Init();

        /* Configure the system clock */
        SystemClock_Config();

        /* Initialize all configured peripherals */
        MX_GPIO_Init();
        MX_TIM15_Init();
        /* USER CODE BEGIN 2 */
        HAL_TIM_PWM_Start(&htim15, TIM_CHANNEL_1);
        /* USER CODE END 2 */

        /* Infinite loop */
        while (1)
            {
                // Raise value to 100% over 0.50 seconds, so 1000/0.5 = 1500 per second
                // 200 PWM periods per second (clock is 200kHz, one period is 1000 counts, so 200,000/1000)
                // Since we only have 200 PWM periods in a second, and want to increase 1500 in a second,
                // 1500/200 = 7.5 per period. Period lasts 0.005 seconds, or 5ms
                // Will wait 2 periods so the increase is an integer: 10ms delay, increase of 15
                if(LED2_Value_Rising){
                    //if value is not going to exceed 1000, increase by 15
                    if(LED2_Value <= (1000-15)){
                        LED2_Value += 15;
                        HAL_Delay(10);
                    }
                    //else start dimming
                    else {
                        LED2_Value_Rising = 0;
                    }

                }

                // Lower value to 0% over 2 seconds, so 1000/2 = 500 per second
                // 200 PWM periods per second (clock is 200kHz, one period is 1000 counts, so 200,000/1000)
                // Since we have 200 PWM periods in a second, and want to decrease 500 in a second,
                // 500/200 = 2.5 per period. Period lasts 0.005 seconds, or 5ms
                // Will wait 2 periods so the increase is an integer: 10ms delay, increase of 5
                else {
                    //if value is not zero, decrease by 5
                    if(LED2_Value >= (0+5)){
                        LED2_Value -= 5;
                        HAL_Delay(10);
                    }
                    //else stop dimming, start increasing brightness
                    else {
                        HAL_Delay(250); //add some off time
                        LED2_Value_Rising = 1;
                    }
                }

                LED2_PWM_SetValue(LED2_Value);
            }
    }

void SystemClock_Config(void)
    {
        RCC_OscInitTypeDef RCC_OscInitStruct = {0};
        RCC_ClkInitTypeDef RCC_ClkInitStruct = {0};

        /** Configure the main internal regulator output voltage
        */
        if (HAL_PWREx_ControlVoltageScaling(PWR_REGULATOR_VOLTAGE_SCALE1) != HAL_OK)
            {
                Error_Handler();
            }
        /** Initializes the RCC Oscillators according to the specified parameters
        * in the RCC_OscInitTypeDef structure.
        */
        RCC_OscInitStruct.OscillatorType = RCC_OSCILLATORTYPE_MSI;
        RCC_OscInitStruct.MSIState = RCC_MSI_ON;
        RCC_OscInitStruct.MSICalibrationValue = 0;
        RCC_OscInitStruct.MSIClockRange = RCC_MSIRANGE_6;
        RCC_OscInitStruct.PLL.PLLState = RCC_PLL_ON;
        RCC_OscInitStruct.PLL.PLLSource = RCC_PLLSOURCE_MSI;
        RCC_OscInitStruct.PLL.PLLM = 1;
        RCC_OscInitStruct.PLL.PLLN = 40;
        RCC_OscInitStruct.PLL.PLLP = RCC_PLLP_DIV7;
        RCC_OscInitStruct.PLL.PLLQ = RCC_PLLQ_DIV2;
        RCC_OscInitStruct.PLL.PLLR = RCC_PLLR_DIV2;
        if (HAL_RCC_OscConfig(&RCC_OscInitStruct) != HAL_OK)
            {
                Error_Handler();
            }
        /** Initializes the CPU, AHB and APB buses clocks
        */
        RCC_ClkInitStruct.ClockType = RCC_CLOCKTYPE_HCLK|RCC_CLOCKTYPE_SYSCLK
            |RCC_CLOCKTYPE_PCLK1|RCC_CLOCKTYPE_PCLK2;
        RCC_ClkInitStruct.SYSCLKSource = RCC_SYSCLKSOURCE_PLLCLK;
        RCC_ClkInitStruct.AHBCLKDivider = RCC_SYSCLK_DIV1;
        RCC_ClkInitStruct.APB1CLKDivider = RCC_HCLK_DIV1;
        RCC_ClkInitStruct.APB2CLKDivider = RCC_HCLK_DIV1;

        if (HAL_RCC_ClockConfig(&RCC_ClkInitStruct, FLASH_LATENCY_4) != HAL_OK)
            {
                Error_Handler();
            }
    }

static void MX_TIM15_Init(void)
    {

        TIM_MasterConfigTypeDef sMasterConfig = {0};
        TIM_OC_InitTypeDef sConfigOC = {0};
        TIM_BreakDeadTimeConfigTypeDef sBreakDeadTimeConfig = {0};

        htim15.Instance = TIM15;
        htim15.Init.Prescaler = 400-1;
        htim15.Init.CounterMode = TIM_COUNTERMODE_UP;
        htim15.Init.Period = 1000-1;
        htim15.Init.ClockDivision = TIM_CLOCKDIVISION_DIV1;
        htim15.Init.RepetitionCounter = 0;
        htim15.Init.AutoReloadPreload = TIM_AUTORELOAD_PRELOAD_DISABLE;
        if (HAL_TIM_PWM_Init(&htim15) != HAL_OK)
            {
                Error_Handler();
            }
        sMasterConfig.MasterOutputTrigger = TIM_TRGO_RESET;
        sMasterConfig.MasterSlaveMode = TIM_MASTERSLAVEMODE_DISABLE;
        if (HAL_TIMEx_MasterConfigSynchronization(&htim15, &sMasterConfig) != HAL_OK)
            {
                Error_Handler();
            }
        sConfigOC.OCMode = TIM_OCMODE_PWM1;
        sConfigOC.Pulse = 500;
        sConfigOC.OCPolarity = TIM_OCPOLARITY_HIGH;
        sConfigOC.OCNPolarity = TIM_OCNPOLARITY_HIGH;
        sConfigOC.OCFastMode = TIM_OCFAST_DISABLE;
        sConfigOC.OCIdleState = TIM_OCIDLESTATE_RESET;
        sConfigOC.OCNIdleState = TIM_OCNIDLESTATE_RESET;
        if (HAL_TIM_PWM_ConfigChannel(&htim15, &sConfigOC, TIM_CHANNEL_1) != HAL_OK)
            {
                Error_Handler();
            }
        sBreakDeadTimeConfig.OffStateRunMode = TIM_OSSR_DISABLE;
        sBreakDeadTimeConfig.OffStateIDLEMode = TIM_OSSI_DISABLE;
        sBreakDeadTimeConfig.LockLevel = TIM_LOCKLEVEL_OFF;
        sBreakDeadTimeConfig.DeadTime = 0;
        sBreakDeadTimeConfig.BreakState = TIM_BREAK_DISABLE;
        sBreakDeadTimeConfig.BreakPolarity = TIM_BREAKPOLARITY_HIGH;
        sBreakDeadTimeConfig.AutomaticOutput = TIM_AUTOMATICOUTPUT_DISABLE;
        if (HAL_TIMEx_ConfigBreakDeadTime(&htim15, &sBreakDeadTimeConfig) != HAL_OK)
            {
                Error_Handler();
            }
        HAL_TIM_MspPostInit(&htim15);

    }

static void MX_GPIO_Init(void)
    {

        /* GPIO Ports Clock Enable */
        __HAL_RCC_GPIOB_CLK_ENABLE();

    }

/* USER CODE BEGIN 4 */
void LED2_PWM_SetValue(uint16_t value)
    {
        //Use macro to set CCR1 during runtime
        //TIM15 + CCR1 offset = (0x40014000) + (0x34) = 0x40014034

        //Having issues with tutorial's method. It appaers to leave the Timer in an un-Ready state after calling config again.
       //Using this macro as a shortcut
        __HAL_TIM_SET_COMPARE(&htim15, TIM_CHANNEL_1, value);

    }
/* USER CODE END 4 */

void HAL_TIM_PeriodElapsedCallback(TIM_HandleTypeDef *htim)
    {
        if (htim->Instance == TIM17) {
            HAL_IncTick();
        }
    }

void Error_Handler(void)
    {
        __disable_irq();
        while (1)
            {
            }
    }

/************************ (C) COPYRIGHT STMicroelectronics *****END OF FILE****/
